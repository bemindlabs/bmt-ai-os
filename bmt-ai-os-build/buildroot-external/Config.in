## bmt-ai-os-build/buildroot-external/Config.in
```kconfig
# bmt-ai-os-build/buildroot-external/Config.in
# BMT AI OS external Kconfig menu
#
# This file is sourced by Buildroot's top-level Config.in when
# BR2_EXTERNAL points to this directory. It surfaces BMT AI OS
# package options inside 'make menuconfig' under a dedicated sub-menu.

menu "BMT AI OS Packages"

comment "AI Inference"
source "$BR2_EXTERNAL_BMT_AI_OS_PATH/package/ollama/Config.in"

comment "Vector Store"
source "$BR2_EXTERNAL_BMT_AI_OS_PATH/package/chromadb/Config.in"

comment "AI Stack Controller"
source "$BR2_EXTERNAL_BMT_AI_OS_PATH/package/bmt-controller/Config.in"

comment "Hardware Acceleration (select per BSP)"
source "$BR2_EXTERNAL_BMT_AI_OS_PATH/package/bmt-npu-stub/Config.in"
source "$BR2_EXTERNAL_BMT_AI_OS_PATH/package/jetson-bsp/Config.in"
source "$BR2_EXTERNAL_BMT_AI_OS_PATH/package/rk3588-bsp/Config.in"
source "$BR2_EXTERNAL_BMT_AI_OS_PATH/package/pi5-hailo-bsp/Config.in"
source "$BR2_EXTERNAL_BMT_AI_OS_PATH/package/apple-silicon-bsp/Config.in"

endmenu
```

## bmt-ai-os-build/buildroot-external/package/bmt-controller/Config.in
```kconfig
config BR2_PACKAGE_BMT_CONTROLLER
	bool "bmt-controller"
	depends on BR2_PACKAGE_PYTHON3
	depends on BR2_PACKAGE_OLLAMA || BR2_PACKAGE_CHROMADB
	help
	  BMT AI OS controller — Python + FastAPI orchestration service.

	  Manages the AI stack containers (Ollama, ChromaDB, training jobs)
	  via docker-py. Exposes an OpenAI-compatible API on port 8080 and
	  telemetry for the Next.js dashboard on port 9090.

	  Source: bmt-ai-os/controller/main.py
```

## bmt-ai-os-build/buildroot-external/package/bmt-npu-stub/Config.in
```kconfig
config BR2_PACKAGE_BMT_NPU_STUB
	bool "bmt-npu-stub (hardware acceleration placeholder)"
	depends on BR2_aarch64
	help
	  Placeholder package for NPU/GPU hardware acceleration.

	  At runtime the controller auto-detects the available accelerator
	  and loads the appropriate backend:

	    Jetson Orin Nano Super  — CUDA / TensorRT (NVIDIA JetPack BSP)
	    RK3588                  — RKNN runtime / RKLLM
	    Pi 5 + Hailo AI HAT+ 2  — HailoRT
	    QEMU / Apple Silicon    — CPU-only fallback (llama.cpp)

	  Replace this stub with the real BSP package recipe for each target.
	  Do NOT enable CUDA, RKNN, or HailoRT on QEMU targets.
```

## bmt-ai-os-build/buildroot-external/package/chromadb/Config.in
```kconfig
config BR2_PACKAGE_CHROMADB
	bool "chromadb"
	depends on BR2_PACKAGE_PYTHON3
	depends on BR2_aarch64
	help
	  ChromaDB — open-source vector database for AI embeddings.

	  Installed as a Python package and launched as an OpenRC service
	  on port 8000. Persistent data is stored under /var/lib/chromadb.

	  RAG latency target: < 3s on Jetson Orin with 7B model + 1K docs.

	  https://www.trychroma.com
```

## bmt-ai-os-build/buildroot-external/package/containerd/Config.in
```kconfig
config BR2_PACKAGE_CONTAINERD
	bool "containerd"
	depends on BR2_aarch64
	depends on BR2_PACKAGE_HOST_GO
	select BR2_PACKAGE_RUNC
	help
	  containerd — an industry-standard container runtime focused on
	  simplicity, robustness, and portability.

	  Provides the core container execution layer for BMT AI OS. Docker
	  connects to containerd via a gRPC socket to manage container
	  lifecycle, image pulls, snapshots, and networking.

	  Includes CRI plugin for optional Kubernetes (k3s) compatibility.

	  Requires runc as the low-level OCI runtime.

	  https://containerd.io

config BR2_PACKAGE_CONTAINERD_VERSION
	string "containerd version"
	default "2.0.4"
	depends on BR2_PACKAGE_CONTAINERD
	help
	  Version of containerd to build. Must match a release tag from
	  https://github.com/containerd/containerd/releases

config BR2_PACKAGE_RUNC
	bool "runc"
	depends on BR2_aarch64
	depends on BR2_PACKAGE_HOST_GO
	help
	  runc — OCI-compliant container runtime.

	  Low-level runtime used by containerd to create and manage
	  containers according to the OCI specification.

	  https://github.com/opencontainers/runc
```

## bmt-ai-os-build/buildroot-external/package/docker-cli/Config.in
```kconfig
config BR2_PACKAGE_DOCKER_CLI
	bool "docker-cli"
	depends on BR2_aarch64
	depends on BR2_PACKAGE_HOST_GO
	select BR2_PACKAGE_CONTAINERD
	help
	  Docker CLI and daemon — container management tools for BMT AI OS.

	  Provides:
	    - dockerd: daemon that connects to containerd for container lifecycle
	    - docker: CLI client for building, running, and managing containers
	    - docker compose: built-in plugin for multi-container applications

	  The Docker daemon uses containerd as its runtime backend and overlay2
	  as the storage driver on the ext4 /data partition.

	  https://docs.docker.com/engine/

config BR2_PACKAGE_DOCKER_CLI_VERSION
	string "Docker Engine version"
	default "28.1.1"
	depends on BR2_PACKAGE_DOCKER_CLI
	help
	  Version of Docker Engine (Moby) to build. Must match a release tag
	  from https://github.com/moby/moby/releases
```

## bmt-ai-os-build/buildroot-external/package/ollama/Config.in
```kconfig
config BR2_PACKAGE_OLLAMA
	bool "ollama"
	depends on BR2_aarch64
	help
	  Ollama — run Qwen and other LLMs locally via a REST API on port 11434.

	  This package installs the Ollama binary. Models are downloaded at
	  first boot and stored in /var/lib/ollama/models.

	  Default model: qwen2.5-coder:7b (configurable via /etc/ollama/config)

	  https://ollama.com
```

## bmt-ai-os/kernel/defconfig
```kconfig
# BMT AI OS — Buildroot defconfig
# Architecture: ARM64 (aarch64)

# === Architecture & Kernel ===
BR2_aarch64=y
BR2_KERNEL_HEADERS_LATEST=y

# Kernel features for containers
# CONFIG_OVERLAY_FS=y
# CONFIG_CGROUPS=y
# CONFIG_NAMESPACES=y
# CONFIG_BRIDGE=y
# CONFIG_VETH=y
# CONFIG_NETFILTER=y

# === Init System ===
BR2_INIT_OPENRC=y

# === Container Runtime ===
BR2_PACKAGE_DOCKER_CLI=y
BR2_PACKAGE_CONTAINERD=y
BR2_PACKAGE_IPTABLES=y
BR2_PACKAGE_BRIDGE_UTILS=y
BR2_PACKAGE_DNSMASQ=y

# === Python Stack ===
BR2_PACKAGE_PYTHON3=y
BR2_PACKAGE_PYTHON3_PIP=y
BR2_PACKAGE_PYTHON3_DEV=y
BR2_PACKAGE_PYTHON3_VENV=y
BR2_PACKAGE_PYTHON3_SETUPTOOLS=y
BR2_PACKAGE_PYTHON3_SQLITE3=y

# === AI Training & ML Framework Support ===
BR2_PACKAGE_PYTHON3_NUMPY=y
BR2_PACKAGE_OPENBLAS=y

# === Node.js Ecosystem ===
BR2_PACKAGE_NODEJS=y
BR2_PACKAGE_NPM=y

# === Build Tools ===
BR2_PACKAGE_MAKE=y
BR2_PACKAGE_GCC=y
BR2_PACKAGE_CMAKE=y
BR2_PACKAGE_PKG_CONFIG=y

# === Networking ===
BR2_PACKAGE_CURL=y
BR2_PACKAGE_WGET=y
BR2_PACKAGE_OPENSSH=y
BR2_PACKAGE_AVAHI=y
BR2_PACKAGE_CA_CERTIFICATES=y
BR2_PACKAGE_OPENSSL=y

# === Storage & Filesystem ===
BR2_PACKAGE_E2FSPROGS=y
BR2_PACKAGE_PARTED=y
BR2_PACKAGE_UTIL_LINUX=y

# === Security ===
BR2_PACKAGE_GNUPG=y

# === Hardware Detection & Monitoring ===
BR2_PACKAGE_I2C_TOOLS=y
BR2_PACKAGE_LM_SENSORS=y
BR2_PACKAGE_USBUTILS=y

# === Developer Tools ===
BR2_PACKAGE_GIT=y
BR2_PACKAGE_HTOP=y
BR2_PACKAGE_NANO=y
BR2_PACKAGE_TMUX=y
BR2_PACKAGE_LESS=y

# === Hardware-Specific (enable per BSP) ===
# Jetson Orin:  BR2_PACKAGE_CUDA=y BR2_PACKAGE_TENSORRT_LLM=y
# RK3588:       BR2_PACKAGE_RKNN_RUNTIME=y BR2_PACKAGE_RKLLM=y
# Pi 5 + Hailo: BR2_PACKAGE_HAILO_RUNTIME=y
```
